## Kconfig
```kconfig
# Kconfig file for package ST7789
menuconfig PKG_USING_ST7789
    bool "Please add description of ST7789 in English."
    default n

if PKG_USING_ST7789

    config PKG_ST7789_PATH
        string
        default "/packages/peripherals/ST7789"

    choice
        prompt "Version"
        default PKG_USING_ST7789_LATEST_VERSION
        help
            Select the package version

        config PKG_USING_ST7789_V100
            bool "v1.0.0"

        config PKG_USING_ST7789_LATEST_VERSION
            bool "latest"
    endchoice

    config PKG_ST7789_VER
       string
       default "v1.0.0"    if PKG_USING_ST7789_V100
       default "latest"    if PKG_USING_ST7789_LATEST_VERSION

endif
```
